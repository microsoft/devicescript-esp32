## sdkconfig.defaults
```kconfig
CONFIG_IDF_TARGET="esp32s2"

CONFIG_USB_ENABLED=y
CONFIG_USB_CDC_ENABLED=y

CONFIG_NEWLIB_ENABLE=y
CONFIG_NEWLIB_LIBRARY_LEVEL_NORMAL=y
CONFIG_NEWLIB_NANO_FORMAT=

CONFIG_SSL_USING_MBEDTLS=y
CONFIG_LWIP_IPV6=y
CONFIG_MBEDTLS_CERTIFICATE_BUNDLE_DEFAULT_NONE=y
CONFIG_MBEDTLS_CUSTOM_CERTIFICATE_BUNDLE=y
CONFIG_MBEDTLS_CUSTOM_CERTIFICATE_BUNDLE_PATH="scripts"

CONFIG_ESP_TASK_WDT_TIMEOUT_S=5
CONFIG_ESP_TASK_WDT_CHECK_IDLE_TASK_CPU0=n
CONFIG_ESP_TASK_WDT=n
```
